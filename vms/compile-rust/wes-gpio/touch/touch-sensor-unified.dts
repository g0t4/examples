/dts-v1/;
/plugin/;

/ {
    compatible = "brcm,bcm2835";  // For Raspberry Pi or relevant SoC

    fragment@0 {
        target-path = "/";
        __overlay__ {
            touch_sensor_unified: touch_sensor_unified@4 { // hex of default pin # 0x4 == 4
                compatible = "touch_sensor";
                gpios = <&gpio 4 0>; // default pin 4
                status = "okay";
            };
        };
    };

    __overrides__ {
        gpio_pin = <&touch_sensor_unified>,"gpios:4", // IIUC 4 is a byte offset, like the second word? // TODO lookup how that works again
                <&touch_sensor_unified>,"reg:0"; // changes @address => touch_sensor_unified@gpio_pin
    };
